## build/conf/bblayers.conf
```bitbake
# POKY_BBLAYERS_CONF_VERSION is increased each time build/conf/bblayers.conf
# changes incompatibly
POKY_BBLAYERS_CONF_VERSION = "2"

BBPATH = "${TOPDIR}"
BBFILES ?= ""

BBLAYERS ?= " \
  ${HOME}/hvisor_build_tool/meta-arm/meta-arm-toolchain \
  ${HOME}/hvisor_build_tool/meta \
  ${HOME}/hvisor_build_tool/meta-poky \
  ${HOME}/hvisor_build_tool/meta-yocto-bsp \
  ${HOME}/hvisor_build_tool/meta-kernel-dev \
  "
```
