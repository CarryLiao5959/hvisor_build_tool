## backup/conf/bblayers.conf
```bitbake
# POKY_BBLAYERS_CONF_VERSION is increased each time build/conf/bblayers.conf
# changes incompatibly
POKY_BBLAYERS_CONF_VERSION = "2"

BBPATH = "${TOPDIR}"
BBFILES ?= ""

BBLAYERS ?= " \
  ${HOME}/hvisor_build_tool/meta-arm/meta-arm-toolchain \
  ${HOME}/hvisor_build_tool/meta \
  ${HOME}/hvisor_build_tool/meta-poky \
  ${HOME}/hvisor_build_tool/meta-yocto-bsp \
  ${HOME}/hvisor_build_tool/meta-kernel-dev \
  ${HOME}/hvisor_build_tool/meta-rust-bin \
  ${HOME}/hvisor_build_tool/meta-openembedded/meta-oe \
  ${HOME}/hvisor_build_tool/meta-openembedded/meta-networking \
  ${HOME}/hvisor_build_tool/meta-openembedded/meta-python \
  "
```

## hvisor/Kconfig
```kconfig
menu "System Configuration"

choice ARCH
    prompt "Architecture"
    default ARCH_AARCH64

    config ARCH_AARCH64
        bool "AArch64"
        select CPU_CORTEX_A57
        select GIC_V3

    config ARCH_RISCV
        bool "RISC-V"

    config ARCH_LOONG
        bool "LoongArch64"
endchoice


choice PLATFORM
    prompt "Platform"
    default PLATFORM_QEMU

    config PLATFORM_QEMU
        bool "QEMU"

    config PLATFORM_NXP
        bool "NXP"
endchoice

endmenu


menu "CPU Configuration"

config CPU_CORTEX_A57
    bool "Enable Cortex-A57 CPU"
    default y

config CPU_COUNT
    int "Number of CPU Cores"
    default 1
    range 1 4

endmenu


menu "Memory Configuration"

config MEMORY_SIZE
    int "Memory Size (MB)"
    default 256
    range 256 1024

config MEMORY_RAM_START
    hex "RAM Physical Start Address"
    default 0x80000000

config MEMORY_RAM_SIZE
    hex "RAM Size"
    default 0x10000000

endmenu


menu "Interrupt Configuration"

config GIC_V3
    bool "Enable ARM GICv3"
    default y

config INTERRUPT_75
    bool "Enable Interrupt 75"
    default y

config INTERRUPT_76
    bool "Enable Interrupt 76"
    default y

config INTERRUPT_78
    bool "Enable Interrupt 78"
    default y

endmenu


menu "PCI Configuration"

config PCI_SUPPORT
    bool "Enable PCI Support"
    default y

config PCI_ECAM_BASE
    hex "PCI ECAM Base Address"
    default 0x4010000000

config PCI_ECAM_SIZE
    hex "PCI ECAM Size"
    default 0x10000000

config PCI_IO_BASE
    hex "PCI IO Base Address"
    default 0x3eff0000

config PCI_IO_SIZE
    hex "PCI IO Size"
    default 0x10000

config PCI_MEM32_BASE
    hex "PCI 32-bit Memory Base"
    default 0x10000000

config PCI_MEM32_SIZE
    hex "PCI 32-bit Memory Size"
    default 0x2eff0000

config PCI_MEM64_BASE
    hex "PCI 64-bit Memory Base"
    default 0x8000000000

config PCI_MEM64_SIZE
    hex "PCI 64-bit Memory Size"
    default 0x8000000000

config NUM_PCI_DEVS
    int "Number of PCI Devices"
    default 1
    range 1 32

endmenu


menu "VirtIO Configuration"

config VIRTIO_SUPPORT
    bool "Enable VirtIO Support"
    default y

config VIRTIO_BLK
    bool "Enable Virtio Block Device"
    default y

config VIRTIO_SERIAL
    bool "Enable Virtio Serial Device"
    default y

config VIRTIO_MMIO
    bool "Enable Virtio MMIO Transport"
    default y

endmenu


menu "Kernel and Boot Configuration"

config KERNEL_FILE
    string "Kernel Image Filepath"
    default "./Image"

config DTB_FILE
    string "Device Tree Blob Filepath"
    default "./linux3.dtb"

config KERNEL_LOAD_PADDR
    hex "Kernel Load Physical Address"
    default 0x80400000

config DTB_LOAD_PADDR
    hex "DTB Load Physical Address"
    default 0x80000000

config ENTRY_POINT
    hex "Kernel Entry Point"
    default 0x80400000

config BOOTARGS
    string "Kernel Boot Arguments"
    default "earlycon=virtio,mmio,0xa004000 console=hvc0 root=/dev/vda rw"

endmenu


menu "Debugging and Testing"

config TRACE_EVENTS
    bool "Enable Trace Events"
    default n

config PCI_TESTDEV
    bool "Enable PCI Test Device"
    default n

endmenu
```

## hvisor/build/Kconfig
```kconfig
choice ARCH
    prompt "Architecture"
    default ARCH_AARCH64

    config ARCH_AARCH64
        bool "AArch64"

    config ARCH_RISCV
        bool "RISC-V"

    config ARCH_LOONG
        bool "LoongArch64"
endchoice


choice PLATFORM
    prompt "Platform"
    default PLATFORM_QEMU

    config PLATFORM_QEMU
        bool "QEMU"

    config PLATFORM_NXP
        bool "NXP"
endchoice


choice VM_COUNT
    prompt "Number of Virtual Machines"
    default VM_COUNT_1
    help
      Select the number of virtual machines to be supported.

    config VM_COUNT_1
        bool "1 VM"

    config VM_COUNT_2
        bool "2 VMs"

    config VM_COUNT_3
        bool "3 VMs"
endchoice


config CPU_COUNT
    int "Number of CPU"
    default 1
    range 1 4


config MEMORY_SIZE
    int "Memory Size (G)"
    default 1
    range 1 4


config VIRTIO_BLK
    bool "Enable Virtio Block Device"
    default y
    help
        Enable support for Virtio block devices in the virtual machine.


config EXTRA_VIRTIO_BLK
    bool "Enable an extra Virtio Block Device"
    default n
    help
        Enable an additional Virtio block device in the virtual machine.


menu "Console and Filesystem Configuration"

config VIRTIO_CONSOLE
    bool "Enable Virtio Console Device"
    default n
    help
        Enable support for Virtio console devices in the virtual machine.


config VIRTIO_9P
    bool "Enable Virtio 9P Filesystem"
    default n
    help
        Enable support for Virtio 9P filesystem sharing.

endmenu


menu "Network Device"

config VIRTIO_NET
    bool "Enable Virtio Network Device"
    default y
    help
        Enable support for Virtio network devices in the virtual machine.


config NETWORK_TAP
    bool "Enable TAP Network Device"
    default n
    help
        Enable a TAP network device for the virtual machine.


config NETWORK_USER
    bool "Enable User Mode Network Device"
    default n
    help
        Enable a user mode network device with port forwarding.


config NETWORK_USER_NET2
    bool "Enable User Mode Network Device net2"
    default n
    help
        Enable a user mode network device 'net2' with specific settings.


config NETWORK_USER_NET3
    bool "Enable User Mode Network Device net3"
    default n
    help
        Enable a user mode network device 'net3' with specific settings.

endmenu


menu "Debugging and Testing Device"

config TRACE_EVENTS
    bool "Enable Trace Events"
    default n
    help
        Enable trace events for debugging purposes.


config PCI_TESTDEV
    bool "Enable PCI Test Device"
    default n
    help
        Enable a PCI test device for development and testing purposes.

endmenu
```
